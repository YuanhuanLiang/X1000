## kernel/arch/mips/xburst/soc-x1000/chip-x1000/Kconfig
```kconfig
choice
	prompt "Board type"
	depends on SOC_X1000
	default PRODUCT_X1000_PHOENIX

config  PRODUCT_X1000_PHOENIX
    bool "product x1000 phoenix"

config	PRODUCT_X1000_HALLEY2
	bool "product x1000 halley2"

config	PRODUCT_X1000_ATHENA_EYES
	bool "product x1000 athena_eyes"

config	PRODUCT_X1000_SOLAR
	bool "product x1000 solar"

config  PRODUCT_X1000_IDRIVER
        bool "product x1000 iDriver"

config  PRODUCT_X1000_SPEAKER
        bool "product x1000 speaker"

config  PRODUCT_X1000_BEETHOVEN
        bool "product x1000 beethoven"

config  PRODUCT_X1000_SKYWORTH
        bool "product x1000 skyworth"

config  PRODUCT_X1000_ILOCK
        bool "product x1000 ilock"

config  PRODUCT_X1000_MS800
        bool "product x1000 ms800"

endchoice

if PRODUCT_X1000_PHOENIX
config PRODUCT_NAME
string
default "phoenix"
source "arch/mips/xburst/soc-x1000/chip-x1000/phoenix/Kconfig"
endif

if PRODUCT_X1000_HALLEY2
config PRODUCT_NAME
string
default "halley2"
source "arch/mips/xburst/soc-x1000/chip-x1000/halley2/Kconfig"
endif

if PRODUCT_X1000_ATHENA_EYES
config PRODUCT_NAME
string
default "athena_eyes"
source "arch/mips/xburst/soc-x1000/chip-x1000/athena_eyes/Kconfig"
endif

if PRODUCT_X1000_SOLAR
config PRODUCT_NAME
string
default "solar"
source "arch/mips/xburst/soc-x1000/chip-x1000/solar/Kconfig"
endif

if PRODUCT_X1000_IDRIVER
config PRODUCT_NAME
string
default "idriver"
source "arch/mips/xburst/soc-x1000/chip-x1000/idriver/Kconfig"
endif

if PRODUCT_X1000_SPEAKER
config PRODUCT_NAME
string
default "speaker"
source "arch/mips/xburst/soc-x1000/chip-x1000/speaker/Kconfig"
endif

if PRODUCT_X1000_BEETHOVEN
config PRODUCT_NAME
string
default "beethoven"
source "arch/mips/xburst/soc-x1000/chip-x1000/beethoven/Kconfig"
endif

if PRODUCT_X1000_SKYWORTH
config PRODUCT_NAME
string
default "skyworth"
source "arch/mips/xburst/soc-x1000/chip-x1000/skyworth/Kconfig"
endif

if PRODUCT_X1000_ILOCK
config PRODUCT_NAME
string
default "ilock"
source "arch/mips/xburst/soc-x1000/chip-x1000/ilock/Kconfig"
endif

if PRODUCT_X1000_MS800
config PRODUCT_NAME
string
default "ms800"
source "arch/mips/xburst/soc-x1000/chip-x1000/ms800/Kconfig"
endif
```

## kernel/arch/mips/xburst/soc-x1000/chip-x1000/athena_eyes/Kconfig
```kconfig
choice
prompt "BOARD version"
depends on PRODUCT_X1000_ATHENA_EYES
default BOARD_X1000_ATHENA_EYES

config BOARD_X1000_ATHENA_EYES
bool "board x1000 athena_eyes"
depends on PRODUCT_X1000_ATHENA_EYES

endchoice

config BOARD_NAME
string
default "athena_eyes" if BOARD_X1000_ATHENA_EYES
```

## kernel/arch/mips/xburst/soc-x1000/chip-x1000/beethoven/Kconfig
```kconfig
choice
prompt "Core Board Version"
depends on PRODUCT_X1000_BEETHOVEN
default BOARD_X1000_BEETHOVEN_V10

config BOARD_X1000_BEETHOVEN_V10
bool "board x1000 beethoven"
depends on PRODUCT_X1000_BEETHOVEN

config BOARD_X1000_BEETHOVEN_CMD
bool "board x1000 beethoven CMD"
depends on PRODUCT_X1000_BEETHOVEN

config BOARD_X1000_BEETHOVEN_HBWY
bool "board x1000 beethoven HBWY"
depends on PRODUCT_X1000_BEETHOVEN

endchoice

config BOARD_NAME
string
default "beethoven_v10" if BOARD_X1000_BEETHOVEN_V10
default "beethoven_cmd" if BOARD_X1000_BEETHOVEN_CMD
default "beethoven_hbwy" if BOARD_X1000_BEETHOVEN_HBWY
```

## kernel/arch/mips/xburst/soc-x1000/chip-x1000/idriver/Kconfig
```kconfig
choice
prompt "BOARD version"
depends on PRODUCT_X1000_IDRIVER
default BOARD_X1000_IDRIVER_V10

config BOARD_X1000_IDRIVER_V10
bool "board x1000 idriver v10"
depends on PRODUCT_X1000_IDRIVER

endchoice

config BOARD_NAME
string
default "idriver_v10" if BOARD_X1000_IDRIVER_V10
```

## kernel/arch/mips/xburst/soc-x1000/chip-x1000/ilock/Kconfig
```kconfig
choice
prompt "Core Board Version"
depends on PRODUCT_X1000_ILOCK
default BOARD_X1000_ILOCK

config BOARD_X1000_ILOCK
bool "board x1000 ilock"
depends on PRODUCT_X1000_ILOCK

config BOARD_X1000_ILOCK_V20
bool "board x1000 lock v20"
depends on PRODUCT_X1000_ILOCK

config BOARD_X1000_ILOCK_V201
bool "board x1000 lock v201"
depends on PRODUCT_X1000_ILOCK

config BOARD_X1000_ILOCK_V21
bool "board x1000 lock v21"
depends on PRODUCT_X1000_ILOCK

config BOARD_X1000_360_S1_ILOCK
bool "board x1000 360 S1 ilock"
depends on PRODUCT_X1000_ILOCK

endchoice

config BOARD_NAME
string
default "ilock" if BOARD_X1000_ILOCK
default "ilock-v20" if BOARD_X1000_ILOCK_V20
default "ilock-v201" if BOARD_X1000_ILOCK_V201
default "ilock-v21" if BOARD_X1000_ILOCK_V21
default "ilock-360-S1" if BOARD_X1000_360_S1_ILOCK
```

## kernel/arch/mips/xburst/soc-x1000/chip-x1000/ms800_bak/Kconfig
```kconfig
choice
prompt "Core Board Version"
depends on PRODUCT_X1000_MS800
default BOARD_X1000_MS800

config BOARD_X1000_MS800_V10
bool "board x1000 ms800 v10"
depends on PRODUCT_X1000_MS800

config BOARD_X1000_SQ22C_V10
bool "board x1000 sq22c v10"
depends on PRODUCT_X1000_MS800

endchoice

config BOARD_NAME
string
default "ms800-v10" if BOARD_X1000_MS800_V10
default "sq22c-v10" if BOARD_X1000_SQ22C_V10
```

## kernel/arch/mips/xburst/soc-x1000/chip-x1000/skyworth/Kconfig
```kconfig
choice
prompt "Core Board Version"
depends on PRODUCT_X1000_SKYWORTH
default BOARD_X1000_SKYWORTH_V10

config BOARD_X1000_SKYWORTH_V10
bool "board x1000 skyworth"
depends on PRODUCT_X1000_SKYWORTH

endchoice

config BOARD_NAME
string
default "skyworth_v10" if BOARD_X1000_SKYWORTH_V10
```

## kernel/arch/mips/xburst/soc-x1000/chip-x1000/solar/Kconfig
```kconfig
choice
prompt "BOARD version"
depends on PRODUCT_X1000_SOLAR
default BOARD_X1000_SOLAR

config BOARD_X1000_SOLAR
bool "board x1000 solar"
depends on PRODUCT_X1000_SOLAR

endchoice

config BOARD_NAME
string
default "solar" if BOARD_X1000_SOLAR
```

## kernel/arch/mips/xburst/soc-x1000/chip-x1000/speaker/Kconfig
```kconfig
choice
prompt "BOARD version"
depends on PRODUCT_X1000_SPEAKER
default BOARD_X1000_SPEAKER

config BOARD_X1000_SPEAKER
bool "board x1000 speaker"
depends on PRODUCT_X1000_SPEAKER

endchoice

config BOARD_NAME
string
default "speaker" if BOARD_X1000_SPEAKER
```

## kernel/arch/mips/xburst/soc-x1000/chip-x1500/Kconfig
```kconfig
choice
	prompt "Board type"
	depends on SOC_X1000
	default PRODUCT_X1500_YAK

config  PRODUCT_X1500_YAK
    bool "product x1500 yak"

config  PRODUCT_X1500_QRCODE
    bool "product x1500 qrcode"
endchoice

if PRODUCT_X1500_YAK
config PRODUCT_NAME
string
default "yak"
source "arch/mips/xburst/soc-x1000/chip-x1500/yak/Kconfig"
endif

if PRODUCT_X1500_QRCODE
config PRODUCT_NAME
string
default "qrcode"
source "arch/mips/xburst/soc-x1000/chip-x1500/qrcode/Kconfig"
endif
```

## kernel/arch/mips/xburst/soc-x1000/chip-x1500/qrcode/Kconfig
```kconfig
choice
prompt "BOARD version"
depends on PRODUCT_X1500_QRCODE
default BOARD_X1500_QRCODE_V10

config BOARD_X1500_QRCODE_V10
bool "qrcode board v10"
depends on PRODUCT_X1500_QRCODE

endchoice

config BOARD_NAME
string
default "qrcode_v10" if BOARD_X1500_QRCODE_V10 
```

## kernel/arch/mips/xburst/soc-x1000/chip-x1500/yak/Kconfig
```kconfig
choice
prompt "BOARD version"
depends on PRODUCT_X1500_YAK
default BOARD_X1500_YAK_V11

config BOARD_X1500_YAK_V11
bool "yak board v11"
depends on PRODUCT_X1500_YAK

endchoice

config BOARD_NAME
string
default "yak_v11" if BOARD_X1500_YAK_V11
```

## kernel/arch/mips/xburst/soc-x1630/Kconfig
```kconfig
choice
	prompt "Chip type"
	depends on SOC_X1630
	default CHIP_X1630

config CHIP_X1630
       bool "chip-x1630"
       select TRACEPOINTS
       select SYS_SUPPORTS_HIGHMEM
       select GENERIC_CLOCKEVENTS_BROADCAST

endchoice

if CHIP_X1630
source "arch/mips/xburst/soc-x1630/chip-x1630/Kconfig"
endif
```

## kernel/arch/mips/xburst/soc-x1630/chip-x1630/Kconfig
```kconfig
choice
	prompt "Platform type"
	depends on CHIP_X1630
	default PLATFORM_X1630_IMP

config PLATFORM_X1630_IMP
	bool "imp"

endchoice

config PRODUCT_NAME
	string
	default "imp" if PLATFORM_X1630_IMP

if PLATFORM_X1630_IMP
source "arch/mips/xburst/soc-x1630/chip-x1630/imp/Kconfig"
endif
```

## kernel/arch/mips/xburst/soc-x1630/chip-x1630/imp/Kconfig
```kconfig
choice
	prompt "Board type"
	depends on PLATFORM_X1630_IMP
	default BOARD_GOLD

config BOARD_GOLD
       bool "gold"
       depends on PLATFORM_X1630_IMP

endchoice

config BOARD_NAME
	string
	default "gold" if BOARD_GOLD
```

## kernel/drivers/chd_gpio/Kconfig
```kconfig
#
# chird GPIO drivers
#

config CHD_GPIO
	tristate "CHD GPIO"
	help
	Select this to enable the chird  GPIO driver
```

## kernel/drivers/chd_mm9932/Kconfig
```kconfig
#
# chird GPIO drivers
#

config MM9932
	tristate "CHD MM9932"
	help
	Select this to enable the chird MM9932 driver
```

## kernel/drivers/chd_pwm/Kconfig
```kconfig
#
# chird GPIO drivers
#

config CHD_PWM
	tristate "CHD PWM"
	help
	Select this to enable the chird PWM driver
```

## kernel/drivers/media/i2c/soc_camera/Kconfig
```kconfig
comment "soc_camera sensor drivers"

config SOC_CAMERA_IMX074
	tristate "imx074 support"
	depends on SOC_CAMERA && I2C
	help
	  This driver supports IMX074 cameras from Sony

config SOC_CAMERA_MT9M001
	tristate "mt9m001 support"
	depends on SOC_CAMERA && I2C
	help
	  This driver supports MT9M001 cameras from Micron, monochrome
	  and colour models.

config SOC_CAMERA_MT9M111
	tristate "mt9m111, mt9m112 and mt9m131 support"
	depends on SOC_CAMERA && I2C
	help
	  This driver supports MT9M111, MT9M112 and MT9M131 cameras from
	  Micron/Aptina

config SOC_CAMERA_MT9T031
	tristate "mt9t031 support"
	depends on SOC_CAMERA && I2C
	help
	  This driver supports MT9T031 cameras from Micron.

config SOC_CAMERA_MT9T112
	tristate "mt9t112 support"
	depends on SOC_CAMERA && I2C
	help
	  This driver supports MT9T112 cameras from Aptina.

config SOC_CAMERA_MT9V022
	tristate "mt9v022 and mt9v024 support"
	depends on SOC_CAMERA && I2C
	help
	  This driver supports MT9V022 cameras from Micron

config SOC_CAMERA_OV2640
	tristate "ov2640 camera support"
	depends on SOC_CAMERA && I2C
	help
	  This is a ov2640 camera driver

config SOC_CAMERA_OV5642
	tristate "ov5642 camera support"
	depends on SOC_CAMERA && I2C
	help
	  This is a V4L2 camera driver for the OmniVision OV5642 sensor

config SOC_CAMERA_OV5640
	tristate "ov5640 camera support"
	depends on SOC_CAMERA && I2C
	help
	  This is a V4L2 camera driver for the OmniVision OV5640 sensor

config SOC_CAMERA_GC0308
	tristate "gc0308 camera support"
	depends on SOC_CAMERA && I2C
	help
	  This is a V4L2 camera driver for the gc0308 sensor

config SOC_CAMERA_GC0308_DOUBLE
	tristate "gc0308 double channel support"
	depends on SOC_CAMERA && I2C && I2C_MUX_PCA9543
	help
	  This is a V4L2 camera driver for the gc0308 double channel

config SOC_CAMERA_GC0328
	tristate "gc0328 camera support"
	depends on SOC_CAMERA && I2C
	help
	  This is a V4L2 camera driver for the gc0328 sensor

config SOC_CAMERA_GC0328_DOUBLE
	tristate "gc0328 double channel support"
	depends on SOC_CAMERA && I2C && I2C_MUX_PCA9543
	help
	  This is a V4L2 camera driver for the gc0328 double channel

config SOC_CAMERA_GC2155
	tristate "gc2155 camera support"
	depends on SOC_CAMERA && I2C
	help
	  This is a V4L2 camera driver for the gc2155 sensor

config SOC_CAMERA_OV6650
	tristate "ov6650 sensor support"
	depends on SOC_CAMERA && I2C
	---help---
	  This is a V4L2 SoC camera driver for the OmniVision OV6650 sensor

config SOC_CAMERA_OV7725
	tristate "ov7725 camera support"
	depends on SOC_CAMERA && I2C
	help
	  This is a ov7725 camera driver

config SOC_CAMERA_OV7740
	tristate "ov7740 camera support"
	depends on SOC_CAMERA && I2C
	help
	  This is a ov7740 camera driver

config SOC_CAMERA_OV9640
	tristate "ov9640 camera support"
	depends on SOC_CAMERA && I2C
	help
	  This is a ov9640 camera driver

config SOC_CAMERA_OV9740
	tristate "ov9740 camera support"
	depends on SOC_CAMERA && I2C
	help
	  This is a ov9740 camera driver

config SOC_CAMERA_OV9282
	tristate "ov9282 fornt camera support"
	depends on SOC_CAMERA && I2C
	help
	  This is a ov9282 camera driver

config SOC_CAMERA_SP1409
	tristate "sp1409 fornt camera support"
	depends on SOC_CAMERA && I2C
	help
	  This is a sp1409 camera driver

config SOC_CAMERA_RJ54N1
	tristate "rj54n1cb0c support"
	depends on SOC_CAMERA && I2C
	help
	  This is a rj54n1cb0c video driver

config SOC_CAMERA_TW9910
	tristate "tw9910 support"
	depends on SOC_CAMERA && I2C
	help
	  This is a tw9910 video driver

config SOC_CAMERA_DOUBLE_CHANNEL
	bool "soc camera double channel"
	depends on SOC_CAMERA_GC0328_DOUBLE || SOC_CAMERA_GC0308_DOUBLE
	default y
	help
	  This is a V4L2 camera driver for the sensor double channel

config SOC_CAMERA_SC031GS
	tristate "sc031gs camera support"
	depends on SOC_CAMERA && I2C
	help
	  This is a V4L2 camera driver for the sc031gs sensor
```

## kernel/drivers/media/i2c/tx-isp_camera/Kconfig
```kconfig
comment "tx-isp camera sensor drivers"

config TX_ISP_CAMERA_SP9250
	tristate "Superpix SP9250 sensor support"
	depends on I2C && VIDEO_TX_ISP
	help
	  This is a tx-isp camera driver for the SP9250 sensor

config TX_ISP_CAMERA_OV2735B
	tristate "OmniVision OV2735B sensor support"
	depends on I2C && VIDEO_TX_ISP
	help
	  This is a tx-isp camera driver for the OV2735B sensor

config TX_ISP_CAMERA_OV9281
	tristate "OmniVision OV9281 sensor support"
	depends on I2C && VIDEO_TX_ISP
	help
	  This is a tx-isp camera driver for the OV9281 sensor

config TX_ISP_CAMERA_GC2375A
	tristate "gc2375a camera support"
	depends on I2C && VIDEO_TX_ISP
	help
	  This is a tx-isp camera driver for the gc2375a sensor

config TX_ISP_CAMERA_GC0328
	tristate "gc0328 camera support"
	depends on I2C && VIDEO_TX_ISP
	help
	  This is a tx-isp camera driver for the gc0328 sensor
```

## kernel/drivers/misc/fingerprint/Kconfig
```kconfig
menuconfig FINGERPRINT
	bool "Fingerprint sensor support"

if FINGERPRINT
config INPUT_BYD_FPS_SPI
        bool "BYD fingerprint support"
        depends on JZ_SPI #(SPI && SPI_MASTER)
        help
	         Say Y here if you have BYD fingerprint
	         sensor hooked to an SPI bus.

config BYD_FINGERPRINT_MAX_NUM
    int "BYD fingerprint the MAX number"
    range 1 100
    default 10
    depends on INPUT_BYD_FPS_SPI
    help
      The maximum number of registered fingers

config FINGERPRINT_MICROARRAY
	bool "MicroArray fingerprint sensor"
	depends on JZ_SPI
	help
	  Support for MicroArray fingerPrint.

config FINGERPRINT_GOODIX_GF5X
	bool "Goodix GF5X fingerprint sensor"
	depends on JZ_SPI
	help
	  Support for Goodix GF5X fingerprint.

config FINGERPRINT_FPC
	bool "FPC fingerprint sensor"
	depends on JZ_SPI
	help
	  Support for FPC fingerprint.

if !VIDEO_JZ_CIM_HOST_V13
config MCLK_PROVIDED_TO_ENCRYPT_IC
	bool "MCLK provided to Yoyon algorithm encrypt IC"
	depends on FINGERPRINT_FPC
	default n
	help
	  MCLK is provided to the Yoyon algorithm encryption IC.
endif
endif
```

## kernel/drivers/misc/lock_body/Kconfig
```kconfig
menuconfig LOCK_BODY
	bool "Lock body support"

if LOCK_BODY

config FXL_LOCK_BODY
	bool "FXL fuxianglai Lock body driver support"
	depends on SGM42507
	help
	  If you say yes here you get support for the fuxianglai Lock body driver.
	  If unsure, say N here.

config MILI_LOCK_BODY
	bool "MILI fuxianglai Lock body driver support"
	depends on SGM42507
	help
	  If you say yes here you get support for the mili Lock body driver.
	  If unsure, say N here.

endif
```

## kernel/drivers/net/wireless/cc1101/Kconfig
```kconfig
menuconfig CC1101
	tristate "CC1101 RF support"

if CC1101
config CC1101_915M
	tristate "CC1101 915MHz RF support"
	depends on JZ_SPI
	help
	  Support for CC1101 915MHz RF Transceiver .
endif
```
